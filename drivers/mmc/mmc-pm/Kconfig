## drivers/mmc/mmc-pm/Kconfig
```kconfig
#
# MMC/SD host controller drivers
#

comment "MMC/SD/SDIO Card Power Management Drivers"

config SW_MMC_POWER_CONTROL
	tristate "SW Card Power Management support"
	depends on SUN4I_MMC_SW
	help
	  This selects Allwinner MMC Card Power Management support.  
	  All power relative gpio control here.
	  
```

## drivers/mmc/sun4i-host/Kconfig
```kconfig
#
# MMC/SD host controller drivers
#

comment "MMC/SD/SDIO Host Controller Drivers"

config SUN4I_MMC_SW
	tristate "SW SUN4I Card Interface support"
	depends on MMC
	help
	  This selects Allwinner SUN4I card support.  If you have an ARM(R)
	  platform with a Multimedia Card slot, say Y or M here.

	  If unsure, say N.
	  
config SUN4I_MMC_SW_DBG
	bool "SW SUN4I Card Host driver debug control"
	depends on SUN4I_MMC_SW
```

## drivers/net/sun3i/Kconfig
```kconfig
config WEMAC
	tristate "wemac support"
	depends on ARM
	---help---
	  Support for softwinner chipset.

	  To compile this driver as a module, choose M here.  The module
	  will be called wemac.
```

## drivers/net/sun4i/Kconfig
```kconfig
config WEMAC
	tristate "wemac support"
	depends on ARM
	select MII
	---help---
	  Support for softwinner chipset.

	  To compile this driver as a module, choose M here.  The module
	  will be called wemac.
```

## drivers/net/wireless/rtl8192cu/Kconfig
```kconfig
config RTL8192CU
	tristate "Realtek 8192C USB WiFi"
	depends on USB
    select WIRELESS_EXT
    select WEXT_PRIV
	---help---
	  Help message of RTL8192CU
```

## drivers/power/axp_power/Kconfig
```kconfig
menuconfig AW_AXP
	bool "AXP Power drivers"
	default n
	---help---
	  This option allows you to select AXP power driver

if AW_AXP

config AW_AXP18
	bool "AXP18 driver"
	---help---
	  AXP18 driver

config AW_AXP19
	tristate "AXP19 driver"
	default y
	---help---
	  AXP19 driver
	  
config AW_AXP20
	tristate "AXP20 driver"
	default y
	---help---
	  AXP20 driver
	  
config AXP_CHARGEINIT
	bool "AXP init charger set"
	default y


endif # !AW_AXP
```

## drivers/spi/sun4i-spi/Kconfig
```kconfig
config SUN4I_SPI_NDMA
        bool "SUN4I SPI Normal DMA mode select"
        depends on SPI_SUN4I
        help
          This selects SPI DMA mode with DMA transfer
          Y select NDMA mode and N select DDMA mode
```

## drivers/video/sun4i/Kconfig
```kconfig
menuconfig LYCHEE_DISPLAY_INIT_CONFIG_SUN4I
	bool "Display Initial Config Select(sun4i)"
	depends on ARCH_SUN4I
	---help---
	default y

choice
	prompt "Select display screen type"
	depends on LYCHEE_DISPLAY_INIT_CONFIG_SUN4I
	default LYCHEE_DISPLAY_SINGLE_SCREEN0
	
config LYCHEE_DISPLAY_SINGLE_SCREEN0
	bool "single screen0, use fb0"
	---help---
	default y
	
config LYCHEE_DISPLAY_SINGLE_SCREEN1
	bool "single screen1, use fb0"
	---help---
	default n
	
config LYCHEE_DISPLAY_DUAL_DIFF_SCREEN
	bool "daul different screen, use fb0 and fb1"
	---help---
	default n

config LYCHEE_DISPLAY_DUAL_SAME_SCREEN
	bool "daul same screen, use fb0(up for screen0, down for screen1)"
	---help---
	default n

config LYCHEE_DISPLAY_DUAL_DIFF_SCREEN_SAME_CONTENTS
	bool "daul different screen same content, use fb0"
	---help---
	default n
endchoice


config LYCHEE_DISPLAY_SCREEN0_OUTPUT_TYPE
	depends on LYCHEE_DISPLAY_INIT_CONFIG_SUN4I && (!LYCHEE_DISPLAY_SINGLE_SCREEN1)
	int "Screen0 output type(0:none 1:lcd 2:tv 3:hdmi 4:vga)"
	---help---
	default 1

config LYCHEE_DISPLAY_SCREEN0_TV_MODE
	depends on LYCHEE_DISPLAY_INIT_CONFIG_SUN4I && (!LYCHEE_DISPLAY_SINGLE_SCREEN1)
	int "Screen0 tv/hdmi mode(0:480i 1:576i 2:480p 3:576p 4:720p50 5:720p60 6:1080i50 7:1080i60 8:1080p24 9:1080p50 10:1080p60 11:pal 14:ntsc)"
	---help---
	used when screen0 output type is tv or hdmi.
	default 4

config LYCHEE_DISPLAY_SCREEN0_VGA_MODE
	depends on LYCHEE_DISPLAY_INIT_CONFIG_SUN4I && (!LYCHEE_DISPLAY_SINGLE_SCREEN1)
	int "Screen0 vga mode(0:1680*1050 1:1440*900 2:1360*768 3:1280*1024 4:1024*768 5:800*600 6:640*480 10:1920*1080 11:1280*720)"
	---help---
	used when screen0 output type is vga
	default 4



config LYCHEE_DISPLAY_SCREEN1_OUTPUT_TYPE
	depends on LYCHEE_DISPLAY_INIT_CONFIG_SUN4I && (!LYCHEE_DISPLAY_SINGLE_SCREEN0) && (!LYCHEE_DISPLAY_DUAL_SAME_SCREEN)
	int "Screen1 output type(0:none 1:lcd 2:tv 3:hdmi 4:vga)"
	---help---
	default 1

config LYCHEE_DISPLAY_SCREEN1_TV_MODE
	depends on LYCHEE_DISPLAY_INIT_CONFIG_SUN4I && (!LYCHEE_DISPLAY_SINGLE_SCREEN0) && (!LYCHEE_DISPLAY_DUAL_SAME_SCREEN)
	int "Screen1 tv/hdmi mode(0:480i 1:576i 2:480p 3:576p 4:720p50 5:720p60 6:1080i50 7:1080i60 8:1080p24 9:1080p50 10:1080p60 11:pal 14:ntsc)"
	---help---
	used when screen0 output type is tv or hdmi.
	default 4

config LYCHEE_DISPLAY_SCREEN1_VGA_MODE
	depends on LYCHEE_DISPLAY_INIT_CONFIG_SUN4I && (!LYCHEE_DISPLAY_SINGLE_SCREEN0) && (!LYCHEE_DISPLAY_DUAL_SAME_SCREEN)
	int "Screen1 vga mode(0:1680*1050 1:1440*900 2:1360*768 3:1280*1024 4:1024*768 5:800*600 6:640*480 10:1920*1080 11:1280*720)"
	---help---
	used when screen0 output type is vga.
	default 4



config LYCHEE_DISPLAY_FB0_DOUBLE_BUFFER
	depends on LYCHEE_DISPLAY_INIT_CONFIG_SUN4I
	bool "fb0 framebuffer double buffer"
	---help---
	default y
	
config LYCHEE_DISPLAY_FB0_WIDTH
	depends on LYCHEE_DISPLAY_INIT_CONFIG_SUN4I
	int "fb0 framebuffer width"
	---help---
	default 800
	
config LYCHEE_DISPLAY_FB0_HEIGHT
	depends on LYCHEE_DISPLAY_INIT_CONFIG_SUN4I
	int "fb0 framebuffer height"
	---help---
	default 480

config LYCHEE_DISPLAY_FB0_FORMAT
	depends on LYCHEE_DISPLAY_INIT_CONFIG_SUN4I
	int "fb0 framebuffer format(4:RGB655 5:RGB565 6:RGB556 7:ARGB1555 8:RGBA5551 9:RGB888 10:ARGB8888 12:ARGB4444)"
	---help---
	default 10

config LYCHEE_DISPLAY_FB0_PIXEL_SEQUENCE
	depends on LYCHEE_DISPLAY_INIT_CONFIG_SUN4I
	int "fb0 framebuffer pixel sequence for ARGB888(0:ARGB 1:BGRA 2:ABGR 3:RGBA)"
	---help---
	default 0



config LYCHEE_DISPLAY_FB1_DOUBLE_BUFFER
	depends on LYCHEE_DISPLAY_INIT_CONFIG_SUN4I && LYCHEE_DISPLAY_DUAL_DIFF_SCREEN
	bool "fb1 framebuffer double buffer"
	---help---
	default y
	
config LYCHEE_DISPLAY_FB1_WIDTH
	depends on LYCHEE_DISPLAY_INIT_CONFIG_SUN4I && LYCHEE_DISPLAY_DUAL_DIFF_SCREEN
	int "fb1 framebuffer width"
	---help---
	default 800
	
config LYCHEE_DISPLAY_FB1_HEIGHT
	depends on LYCHEE_DISPLAY_INIT_CONFIG_SUN4I && LYCHEE_DISPLAY_DUAL_DIFF_SCREEN
	int "fb1 framebuffer height"
	---help---
	default 480

config LYCHEE_DISPLAY_FB1_FORMAT
	depends on LYCHEE_DISPLAY_INIT_CONFIG_SUN4I && LYCHEE_DISPLAY_DUAL_DIFF_SCREEN
	int "fb1 framebuffer format(4:RGB655 5:RGB565 6:RGB556 7:ARGB1555 8:RGBA5551 9:RGB888 10:ARGB8888 12:ARGB4444)"
	---help---
	default 10

config LYCHEE_DISPLAY_FB1_PIXEL_SEQUENCE
	depends on LYCHEE_DISPLAY_INIT_CONFIG_SUN4I && LYCHEE_DISPLAY_DUAL_DIFF_SCREEN
	int "fb1 pixel sequence for ARGB888(0:ARGB 1:BGRA 2:ABGR 3:RGBA)"
	---help---
	default 0
```

## sound/soc/sun4i/Kconfig
```kconfig
config SND_SUN4I_SOC_CODEC
	tristate "APB On-Chip Codec"
	default n

config SND_SUN4I_SOC_SPDIF
	tristate "sun4i On-Chip spdif"
	default n

config SND_SUN4I_SOC
	tristate "SoC Audio for the AllWinner SUN4I chips"
	default n
	help
	  Say Y or M if you want to add support for codecs attached to
	  the SUN4I AC97, I2S or PCM interface. You will also need
	  to select the audio interfaces to support below.

#config SND_SUN4I_SOC_HDMI
#	tristate "HDMI I2S Audio Out"
#	depends on SND_SUN4I_SOC
#	default n

#config SND_SUN4I_SOC_AC97
	#depends on SND_SUN4I_SOC
	#tristate "AC97 Audio Out"
```
